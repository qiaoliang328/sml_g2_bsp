## build/boards/cv184x/cv1841cp_sml_g2_spinor/cv1841cp_sml_g2_spinor_defconfig
```kconfig
CONFIG_CHIP_cv1841cp=y
CONFIG_BOARD_sml_g2_spinor=y
CONFIG_DDR_CFG_ddr3_1866_x16=y
CONFIG_ARCH="arm"
CONFIG_CC_OPTIMIZE_FOR_SIZE=y
CONFIG_KERNEL_ENTRY_HACK=y
# CONFIG_TOOLCHAIN_GLIBC_ARM=y
CONFIG_TOOLCHAIN_MUSL_ARM=y
CONFIG_FLASH_SIZE_SHRINK=y
CONFIG_BOOT_IMAGE_SINGLE_DTB=y
CONFIG_STORAGE_TYPE_spinor=y
#CONFIG_SENSOR_GCORE_GC8613=y
CONFIG_SENSOR_SONY_IMX376=y
CONFIG_UBOOT_2021_10=y
CONFIG_KERNEL_SRC_5.10=y
CONFIG_KERNEL_SRC="linux_5.10"
CONFIG_KERNEL_LZMA=y
CONFIG_SKIP_RAMDISK=y
CONFIG_USE_4K_ERASE_SIZE_FOR_JFFS2=y
CONFIG_SENSOR_TUNING_PARAM_cv184x_src_cvsens_cv2003=y
#CONFIG_TARGET_PACKAGE_DROPBEAR=y
#CONFIG_TARGET_PACKAGE_NTP=y
CONFIG_TARGET_PACKAGE_GDBSERVER=n
CONFIG_TARGET_PACKAGE_LIBCRYPTO=n
CONFIG_TARGET_PACKAGE_LIBZ=n
CONFIG_TARGET_PACKAGE_OTASERVER=n
CONFIG_TARGET_PACKAGE_CRONTABS=n

CONFIG_DUAL_OS=y
CONFIG_ENABLE_ALIOS=y
CONFIG_NORM_SOLUTION=y
CONFIG_CV1841CP_SML_G2_SPINOR=y
CONFIG_RTOS_BUILD_IN_FIP=n
CONFIG_DRAM_SIZE=0x08000000
CONFIG_ION_SIZE=0xA00000
CONFIG_RTOS_SYS_SIZE=0x400000
# 0x8000000 = 128M
CONFIG_RTOS_ION_SIZE=0x4600000

#
# Partition Configuration
#
CONFIG_FLASH_SIZE="32MB"
CONFIG_PARTITION_COUNT=8
CONFIG_PARTITION_1=y
CONFIG_PARTITION_1_LABEL="fip"
CONFIG_PARTITION_1_SIZE="2048"
CONFIG_PARTITION_1_FILE="fip_spl.bin"
CONFIG_PARTITION_1_MOUNTPOINT=""
CONFIG_PARTITION_1_TYPE=""

CONFIG_PARTITION_2=y
CONFIG_PARTITION_2_LABEL="2nd"
CONFIG_PARTITION_2_SIZE="2048"
CONFIG_PARTITION_2_FILE="yoc.bin"
CONFIG_PARTITION_2_MOUNTPOINT=""
CONFIG_PARTITION_2_TYPE=""
CONFIG_PARTITION_3=y

CONFIG_PARTITION_3_LABEL="BOOT"
CONFIG_PARTITION_3_SIZE="4096"
CONFIG_PARTITION_3_FILE="boot.spinor"
CONFIG_PARTITION_3_MOUNTPOINT=""
CONFIG_PARTITION_3_TYPE=""

CONFIG_PARTITION_4=y
CONFIG_PARTITION_4_LABEL="MISC"
CONFIG_PARTITION_4_SIZE="128"
CONFIG_PARTITION_4_FILE="logo.jpg"
CONFIG_PARTITION_4_MOUNTPOINT=""
CONFIG_PARTITION_4_TYPE=""

CONFIG_PARTITION_5=y
CONFIG_PARTITION_5_LABEL="ENV"
CONFIG_PARTITION_5_SIZE="64"
CONFIG_PARTITION_5_FILE=""
CONFIG_PARTITION_5_MOUNTPOINT=""
CONFIG_PARTITION_5_TYPE=""

CONFIG_PARTITION_6=y
CONFIG_PARTITION_6_LABEL="ENV_BAK"
CONFIG_PARTITION_6_SIZE="64"
CONFIG_PARTITION_6_FILE=""
CONFIG_PARTITION_6_MOUNTPOINT=""
CONFIG_PARTITION_6_TYPE=""

CONFIG_PARTITION_7=y
CONFIG_PARTITION_7_LABEL="ROOTFS"
CONFIG_PARTITION_7_SIZE="14336"
CONFIG_PARTITION_7_FILE="rootfs.spinor"
CONFIG_PARTITION_7_MOUNTPOINT=""
CONFIG_PARTITION_7_TYPE=""

CONFIG_PARTITION_8=y
CONFIG_PARTITION_8_LABEL="DATA"
CONFIG_PARTITION_8_SIZE="1024"
CONFIG_PARTITION_8_FILE="data.spinor"
CONFIG_PARTITION_8_MOUNTPOINT="/mnt/data"
CONFIG_PARTITION_8_TYPE="jffs2"
# end of Partition Configuration

# evtest
CONFIG_TARGET_PACKAGE_EVTEST=y

# adbd
CONFIG_TARGET_PACKAGE_ADBD=y

# rw rootfs; nor flash is not supporte rootfs rw
#CONFIG_ROOTFS_RW=y

# media init
CONFIG_RTOS_INIT_MEDIA=y

# virtual uart
#CONFIG_VIRTUAL_UART=y

# wifi tools
CONFIG_TARGET_PACKAGE_WIFI=y
CONFIG_TARGET_PACKAGE_LIBIPERF=y
CONFIG_TARGET_PACKAGE_IPERF3=y

# pinmux
CONFIG_TARGET_PACKAGE_PINMUX=y

# dhcpcd
CONFIG_TARGET_PACKAGE_DHCPCD=y

# umtprd
#CONFIG_TARGET_PACKAGE_UMTPRD=y

# ND
CONFIG_OD_CLK_SEL=n

# UBOOT SPL, ql edit :must be no in norflash
#CONFIG_UBOOT_SPL_CUSTOM=y

# kernel lz4
CONFIG_KERNEL_LZ4=y

# rtos compress
CONFIG_RTOS_COMPRESS_ORIG=y

# usb key download
CONFIG_ENABLE_BURN_BUTTON=y
CONFIG_GPIO_GRP=1
CONFIG_GPIO_PIN=3

# 关闭 debug 日志
CONFIG_BUILD_FOR_DEBUG=n

# pack bootlogo
CONFIG_PACK_BOOTLOGO=y
```
